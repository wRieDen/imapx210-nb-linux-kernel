## .fr-6uv8kk/SY_7800HE_DEV_SourceCode_20131029/kernel/drivers/i2c/chips/Kconfig
```kconfig
menu "Miscellaneous I2C Chip support"

config BOSCH_BMA150
	tristate "SMB380/BMA150 acceleration sensor support"
	depends on I2C=y
	help
	If you say yes here you get support for Bosch Sensortec's
	acceleration sensors SMB380/BMA150.

endmenu
```
